## drivers/gpu/drm/borg/Kconfig
```kconfig
# SPDX-License-Identifier: GPL-2.0-only
config DRM_BORG
	tristate "Borg Graphics cards"
	depends on DRM
	default y
        select DRM_GEM_SHMEM_HELPER
	help
	  Choose this option for open-source Borg Graphics support.
```
